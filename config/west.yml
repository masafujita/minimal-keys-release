## config/west.yml
```yaml
manifest:
  remotes:
    - name: zmkfirmware
      url-base: https://github.com/zmkfirmware
    - name: hyhy-masa
      url-base: https://github.com/hyhy-masa
    - name: caksoylar
      url-base: https://github.com/caksoylar
  projects:
    - name: zmk
      remote: zmkfirmware
      revision: e34793e8
      import: app/west.yml
    - name: zmk-pmw3610-driver
      remote: hyhy-masa
      revision: d5bd0ec
    - name: zmk-rgbled-widget
      remote: caksoylar
      revision: fbe6dde
  self:
    path: config
```
